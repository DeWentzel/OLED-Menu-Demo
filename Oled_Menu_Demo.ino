/*
created by @dewentzel on 10/21/2024

This is a code for a SSD 1306 Oled display to display a menu with submenus to run on a Arduino Uno (Or similar boards with i2C)
You can navigate through the menu via using a joystick and button. 


The bitmap was made with https://diyusthad.com/image2cpp 

List Of Components:

1x Arduino UNO (Or similar boards with i2C)
1x SSD 1306 128x64 OLED Display
1x Breadboard 
1x Pushbutton
1x Joystick

Connections:

SSD 1306 Oled Display:

VCC --> 5V
GND --> GND
SCL --> SCL OR A5
SDA --> SDA OR A4


GND --> GND
+5V --> 5V
VRX --> A2
VRY --> A1
SW  --> A0

Button:  

OUT --> A3

*/







#include <Adafruit_GFX.h>
#include <Adafruit_SSD1306.h>

// OLED display settings
#define SCREEN_WIDTH 128
#define SCREEN_HEIGHT 64
Adafruit_SSD1306 display(SCREEN_WIDTH, SCREEN_HEIGHT, &Wire, -1);

// Joystick pins
#define JOY_X A1
#define JOY_Y A2
#define JOY_BTN 3

// Button pins
#define BTN_MENU A0
#define BTN_BACK A3

// LED and other pins
#define BUILT_IN_LED LED_BUILTIN
#define PIN_3 13

// Menu settings
const char* menuOptions[] = {"Submenu 1", "Submenu 2", "Submenu 3", "Submenu 4"};
const char* customTexts[] = {
  "This is Submenu 1",
  "This is Submenu 2",
  "This is Submenu 3",
  "This is Submenu 4"
};

const unsigned char Home_Screen[] PROGMEM = { 0x00, 0x00, 0x00, 0x00, 0x00, 0x00, 0x00, 0x00, 0x00, 0x00, 0x00, 0x00, 0x00, 0x00, 0x00, 0x00, 
	0x00, 0x00, 0x00, 0x00, 0x00, 0x00, 0x00, 0x00, 0x00, 0x00, 0x00, 0x00, 0x00, 0x00, 0x00, 0x00, 
	0x00, 0x00, 0x00, 0x00, 0x00, 0x00, 0x00, 0x00, 0x00, 0x00, 0x00, 0x00, 0x00, 0x00, 0x00, 0x00, 
	0x00, 0x00, 0x3f, 0xfc, 0x00, 0x00, 0x00, 0x0f, 0xff, 0x00, 0x00, 0x00, 0x00, 0x01, 0xff, 0xff, 
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	0x00, 0x00, 0x00, 0x00, 0x00, 0x00, 0x00, 0x00, 0x00, 0x00, 0x00, 0x00, 0x00, 0x00, 0x00, 0x00
   };

int currentSelection = 0;
bool isMenu = false;
bool isSubPage = false;

unsigned long lastMoveTime = 0; // For debouncing joystick movement

void setup() {
  pinMode(JOY_BTN, INPUT_PULLUP);
  pinMode(BTN_MENU, INPUT_PULLUP);
  pinMode(BTN_BACK, INPUT_PULLUP);


  Serial.begin(9600);

  display.begin(SSD1306_SWITCHCAPVCC, 0x3C);

  display.clearDisplay();
  display.setTextSize(2);
  display.setTextColor(SSD1306_WHITE);
  displayHome();
}

void loop() {
  if (!isMenu && digitalRead(BTN_MENU) == LOW) {
    isMenu = true;
    displayMenu();
    delay(200);
  }

  if (isMenu && !isSubPage) {
    handleJoystick();
    if (digitalRead(BTN_MENU) == LOW) {
      isSubPage = true;
      displaySubPage(currentSelection);
      delay(200);
    }

    if (digitalRead(BTN_BACK) == LOW) {
      isMenu = false;
      displayHome();
      delay(200);
    }
  }

  if (isSubPage) {
    if (digitalRead(BTN_BACK) == LOW) {
      isSubPage = false;
      isMenu = false; // Exit everything
      displayHome();
      delay(200);
    }
  }
}

void displayHome() {
  display.clearDisplay();
  display.drawBitmap(25, 0, Home_Screen, 90, 64, SSD1306_WHITE);
  display.display();
}

void displayMenu() {
  display.clearDisplay();
  display.setTextSize(1);
  for (int i = 0; i < 4; i++) {
    display.setCursor(10, 10 + i * 12);
    display.print(menuOptions[i]);
  }
  highlightSelection();
  display.display();
}

void highlightSelection() {
  display.drawRect(5, 8 + currentSelection * 12, 118, 12, SSD1306_WHITE);
}

void handleJoystick() {
  int joyY = analogRead(JOY_Y);
  unsigned long currentTime = millis();

  if (currentTime - lastMoveTime > 200) { 
    if (joyY < 400) {
      currentSelection = max(0, currentSelection - 1);
    } else if (joyY > 600) {
      currentSelection = min(3, currentSelection + 1);
    }

    displayMenu();
    lastMoveTime = currentTime;
  }
}

void displaySubPage(int option) {
  display.clearDisplay();
  display.setTextSize(1);

  if (option < 3) {
    display.setCursor(10, 25);
    display.print(customTexts[option]);
    display.display();
    executeMenuOption(option);
  } else if (option == 3) {
    display.setCursor(10, 25);
    display.print(customTexts[option]);
    display.display();
    executeMenuOption(option);
  }
}

void executeMenuOption(int option) {
  switch (option) {
    case 0: 
      digitalWrite(BUILT_IN_LED, HIGH);
      break;
    case 1: 
      Serial.println("Hello, world!");
      break;
    case 2: 
      digitalWrite(BUILT_IN_LED, LOW);
      break;
    case 3: 
      
      break;
  }
}
